// SPDX-License-Identifier: (GPL-2.0+ OR MIT)
/*
 * Copyright (C) 2025 Enclustra GmbH
 * <info@enclustra.com>
 */

/* Devicetree include file for Mercury+ ST1 */

&i2c1 {
	si5338@70 {
		/* No driver available */
		status = "disabled";
		compatible = "silabs,si5338";
		reg = <0x70>;
	};
};
