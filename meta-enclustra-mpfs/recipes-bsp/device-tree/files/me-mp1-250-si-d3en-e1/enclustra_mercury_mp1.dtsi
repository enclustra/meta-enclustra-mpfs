// SPDX-License-Identifier: (GPL-2.0+ OR MIT)
/*
 * Copyright (C) 2025 Enclustra GmbH
 * <info@enclustra.com>
 */

#include "enclustra_mercury_mp1_common.dtsi"

/ {
	model = "enclustra,me-mp1-250-si-d3en";

	aliases {
		ethernet0 = &mac1;
	};

	/* 2 Gbyte DDR4 memory */
	mss_memory: memory@1000000000 {
		device_type = "memory";
		reg = <0x10 0x0 0x0 0x80000000>;
		status = "okay";
	};
};
