## meta-enclustra-module/conf/machine/me-mp1-generic.conf
```bitbake
#@TYPE: Machine
#@NAME: me-mp1-generic
#@SOC: Polarfire SoC
#@DESCRIPTION: Machine configuration for the Enclustra MP1 module

MACHINEOVERRIDES =. "${@['', 'me-mp1-generic:']['me-mp1-generic' !='${MACHINE}']}"

require conf/machine/include/riscv/tune-riscv.inc

MACHINE_FEATURES = "keyboard ext2 serial usbgadget usbhost"
MACHINE_TYPE = "smp"

KERNEL_CLASSES = "kernel-fitimage"
KERNEL_IMAGETYPE = "fitImage"
EXTERNAL_KERNEL_DEVICETREE ?= "devicetree/enclustra_mercury_mp1.dtb"

PREFERRED_PROVIDER_virtual/kernel ?= "mpfs-linux"
PREFERRED_PROVIDER_virtual/dtb ?= "device-tree"

PREFERRED_VERSION_openocd-native = "riscv"
PREFERRED_VERSION_openocd = "riscv"

UBOOT_MACHINE="enclustra_mercury_mp1_defconfig"
PREFERRED_PROVIDER_virtual/bootloader = "u-boot-mchp"
UBOOT_DEVICE_TREE ?= "enclustra_mercury_mp1.dtb"
UBOOT_ENTRYPOINT = "0x84200000"
UBOOT_DTB_LOADADDRESS = "0x86200000"

HSS_PAYLOAD = "uboot"

MACHINE_ESSENTIAL_EXTRA_RDEPENDS += " kernel-modules"

IMAGE_FSTYPES += "ext4"
```

## meta-enclustra-module/recipes-bsp/u-boot/files/enclustra_mercury_mp1_defconfig
```kconfig
CONFIG_RISCV=y
CONFIG_SYS_MALLOC_LEN=0x800000
CONFIG_SYS_MALLOC_F_LEN=0x2000
CONFIG_HAS_CUSTOM_SYS_INIT_SP_ADDR=y
CONFIG_CUSTOM_SYS_INIT_SP_ADDR=0x1000200000
CONFIG_SF_DEFAULT_SPEED=50000000
CONFIG_ENV_SIZE=0x2000
CONFIG_DEFAULT_DEVICE_TREE="enclustra_mercury_mp1"
CONFIG_SYS_PROMPT="Mercury-MP1 # "
CONFIG_SYS_LOAD_ADDR=0x1000200000
CONFIG_TARGET_ENCLUSTRA_MERCURY_MP1=y
CONFIG_ARCH_RV64I=y
CONFIG_RISCV_SMODE=y
CONFIG_FIT=y
CONFIG_DISTRO_DEFAULTS=y
CONFIG_DISPLAY_CPUINFO=y
CONFIG_DISPLAY_BOARDINFO=y
CONFIG_SYS_BOOTM_LEN=0x4000000
CONFIG_CMD_MTD=y
CONFIG_CMD_MTDPARTS=y
CONFIG_ENV_IS_IN_FAT=y
CONFIG_ENV_FAT_DEVICE_AND_PART="0:1"
CONFIG_SYS_RELOC_GD_ENV_ADDR=y
CONFIG_BOOTP_SEND_HOSTNAME=y
CONFIG_MISC=y
CONFIG_ENCLUSTRA_EEPROM_MAC=y
CONFIG_DM_MTD=y
CONFIG_MTD_SPI_NAND=y
CONFIG_SPI_FLASH_SPANSION=y
```
