// SPDX-License-Identifier: (GPL-2.0+ OR MIT)
/*
 * Copyright (C) 2025 Enclustra GmbH
 * <info@enclustra.com>
 */

#include "enclustra_mercury_mp1_common_fabric.dtsi"

&fic3_512m {
	gpio_led@0 {
		compatible = "generic-uio";
		linux,uio-name = "fic3-gpio-led";
		status = "okay";
		reg = <0x0 0x1000000>;
	};

	sdio_sel@1000000 {
		compatible = "generic-uio";
		linux,uio-name = "fic3-sdio-sel";
		status = "okay";
		reg = <0x1000000 0x1000000>;
	};

	uart_sel@2000000 {
		compatible = "generic-uio";
		linux,uio-name = "fic3-uart-sel";
		status = "okay";
		reg = <0x2000000 0x1000000>;
	};
};
